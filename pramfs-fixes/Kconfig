## pramfs-fixes/Kconfig
```kconfig
config PRAMFS
	tristate "Persistent and Protected RAM file system support"
	depends on HAS_IOMEM
	select CRC32
	help
	   If your system has a block of fast (comparable in access speed to
	   system memory) and non-volatile RAM and you wish to mount a
	   light-weight, full-featured, and space-efficient filesystem over it,
	   say Y here, and read <file:Documentation/filesystems/pramfs.txt>.

	   To compile this as a module,  choose M here: the module will be
	   called pramfs.

config PRAMFS_XIP
	bool "Execute-in-place in PRAMFS"
	depends on PRAMFS && BLOCK
	help
	   Say Y here to enable XIP feature of PRAMFS.

config PRAMFS_WRITE_PROTECT
	bool "PRAMFS write protection"
	depends on PRAMFS && MMU && HAVE_SET_MEMORY_RO
	default y
	help
	   Say Y here to enable the write protect feature of PRAMFS.

config PRAMFS_XATTR
	bool "PRAMFS extended attributes"
	depends on PRAMFS && BLOCK
	help
	  Extended attributes are name:value pairs associated with inodes by
	  the kernel or by users (see the attr(5) manual page, or visit
	  <http://acl.bestbits.at/> for details).

	  If unsure, say N.

config PRAMFS_POSIX_ACL
	bool "PRAMFS POSIX Access Control Lists"
	depends on PRAMFS_XATTR
	select FS_POSIX_ACL
	help
	  Posix Access Control Lists (ACLs) support permissions for users and
	  groups beyond the owner/group/world scheme.

	  To learn more about Access Control Lists, visit the Posix ACLs for
	  Linux website <http://acl.bestbits.at/>.

	  If you don't know what Access Control Lists are, say N.

config PRAMFS_SECURITY
	bool "PRAMFS Security Labels"
	depends on PRAMFS_XATTR
	help
	  Security labels support alternative access control models
	  implemented by security modules like SELinux.  This option
	  enables an extended attribute handler for file security
	  labels in the pram filesystem.

	  If you are not using a security module that requires using
	  extended attributes for file security labels, say N.

config PRAMFS_TEST
	boolean
	depends on PRAMFS

config PRAMFS_TEST_MODULE
	tristate "PRAMFS Test"
	depends on PRAMFS && PRAMFS_WRITE_PROTECT && m
	select PRAMFS_TEST
	help
	  Say Y here to build a simple module to test the protection of
	  PRAMFS. The module will be called pramfs_test.
```
